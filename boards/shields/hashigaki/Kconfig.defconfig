## boards/shields/tester/Kconfig.defconfig
```kconfig
if SHIELD_TESTER_DONGLE

config ZMK_KEYBOARD_NAME
    default "ZMK Tester"

config ZMK_SPLIT_ROLE_CENTRAL
    default y

config ZMK_SPLIT_BLE_CENTRAL_PERIPHERALS
    default 1

endif

if SHIELD_TESTER_DONGLE || SHIELD_TESTER_LEFT

config ZMK_SPLIT
    default y

endif
```

## boards/shields/tester/Kconfig.shield
```kconfig
config SHIELD_TESTER_DONGLE
    def_bool $(shields_list_contains,tester_dongle)

config SHIELD_TESTER_LEFT
    def_bool $(shields_list_contains,tester_left)
```
